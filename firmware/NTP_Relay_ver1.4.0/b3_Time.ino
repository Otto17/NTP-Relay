//********** ОБРАБОТКА РАБОТЫ РЕЛЕ **********//


void WorkRelay() {
  //Переводит чч:мм:сс в одно число (секунды) для удобства при сравнении
  NTP_str = (ntp.hour() * 3600) + (ntp.minute() * 60) + ntp.second();  // Перевод времени с NTP


  //Проверка и сравнение установленого интервала времени
  if (Start_str < End_str) {                          // Если время начала МЕНЬШЕ времени окончания работы реле, то выполняем следующие условия...
    if (NTP_str >= Start_str && NTP_str < End_str) {  // Если время с NTP больше или равно времени начала и меньше времени окончания...
      digitalWrite(SW_RELAY, LOW);                    // Включаем реле (инверсия)
      digitalWrite(INDICATOR, LOW);                   // Включаем индикатор (инверсия)

    } else if (NTP_str >= End_str) {  // Иначе, если время с NTP больше или равно времени окончания работы реле...
      digitalWrite(SW_RELAY, HIGH);   // Выключаем реле (инверсия)
      digitalWrite(INDICATOR, HIGH);  // Выключаем индикатор (инверсия)
    }

  } else {                          // Иначе...
    digitalWrite(SW_RELAY, HIGH);   // Выключаем реле (инверсия)
    digitalWrite(INDICATOR, HIGH);  // Выключаем индикатор (инверсия)
  }



  //Инвертированная проверка и сравнение установленого интервала времени
  if (Start_str > End_str) {                         // Если время начала БОЛЬШЕ времени окончания работы реле, то выполняем следующие условия...
    if (NTP_str >= Start_str && NTP_str <= 86399) {  // Если время с NTP больше или равно времени начала работы реле и меньше или равно 23:59:59, то...
      digitalWrite(SW_RELAY, LOW);                   // Включаем реле (инверсия)
      digitalWrite(INDICATOR, LOW);                  // Включаем индикатор (инверсия)

    } else if (NTP_str < End_str) {  // Иначе, если время с NTP меньше времени окончания работы реле...
      digitalWrite(SW_RELAY, LOW);   // Включаем реле (инверсия)
      digitalWrite(INDICATOR, LOW);  // Включаем индикатор (инверсия)

    } else if (NTP_str >= End_str && NTP_str < Start_str) {  // Иначе, если время с NTP больше или равно времени окончания и меньше времени начала работы реле...
      digitalWrite(SW_RELAY, HIGH);                          // Выключаем реле (инверсия)
      digitalWrite(INDICATOR, HIGH);                         // Выключаем индикатор (инверсия)
    }
  }
}
